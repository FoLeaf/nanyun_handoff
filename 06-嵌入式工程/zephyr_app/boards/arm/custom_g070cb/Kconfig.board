## 06-嵌入式工程/zephyr_app/boards/arm/custom_g070cb/Kconfig.board
```kconfig
config BOARD_CUSTOM_G070CB
	bool "Custom STM32G070CBT6 Board"
	depends on SOC_STM32G070XX
```

## 06-嵌入式工程/zephyr_app/boards/arm/custom_g070cb/custom_g070cb_defconfig
```kconfig
CONFIG_BOARD_CUSTOM_G070CB=y
CONFIG_SOC_SERIES_STM32G0X=y
CONFIG_SOC_STM32G070XX=y
CONFIG_CORTEX_M_SYSTICK=y

# Hardware clock configuration
CONFIG_CLOCK_CONTROL=y

# Device drivers
CONFIG_SERIAL=y
CONFIG_CONSOLE=y
CONFIG_UART_CONSOLE=y
CONFIG_GPIO=y
CONFIG_PINCTRL=y
```
